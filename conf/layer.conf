## conf/layer.conf
```bitbake
# LAYER_CONF_VERSION is increased each time a change is made to the conf/layer.conf
# file, and should be reset to 1 whenever the layer is renamed or moved to a
# different location.
LCONF_VERSION = "7"

# This should only be incremented on significant changes that will
# cause compatibility issues with other layers
LAYERVERSION_meta-custom = "1"
LAYERDEPENDS_meta-custom = "core openembedded-layer"

BBPATH .= ":${LAYERDIR}"
BBFILES += "${LAYERDIR}/recipes-*/*/*.bb \
            ${LAYERDIR}/recipes-*/*/*.bbappend"
```
